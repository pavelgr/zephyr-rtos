## drivers/sensor/bosch/bmp280/Kconfig
```kconfig
# Copyright (c) 2020 Facebook, Inc. and its affiliates
# Copyright (c) 2024 pck
# SPDX-License-Identifier: Apache-2.0

menuconfig BMP280
	bool "Bosch BMP280 pressure sensor"
	default y
	depends on DT_HAS_BOSCH_BMP280_ENABLED
	select I2C if $(dt_compat_on_bus,$(DT_COMPAT_BOSCH_BMP280),i2c)
	select SPI if $(dt_compat_on_bus,$(DT_COMPAT_BOSCH_BMP280),spi)
	help
	  Enable driver for the Bosch BMP280 pressure sensor

if BMP280

config BMP280_BUS_I2C
	bool
	default y
	depends on $(dt_compat_on_bus,$(DT_COMPAT_BOSCH_BMI270),i2c)

config BMP280_BUS_SPI
	bool
	default y
	depends on $(dt_compat_on_bus,$(DT_COMPAT_BOSCH_BMI270),spi)

config BMP280_REBOOT_ON_INIT
	bool "Soft reboot the sernsor on init, adds 2s to init duration."
	default y

endif # BMP280
```

## drivers/sensor/tdk/mpu9150/Kconfig
```kconfig
# MPU9150 Nine-Axis Motion Tracking device configuration options

# Copyright (c) 2021 Nordic Semiconductor ASA
# Copyright (c) 2024 pck
# SPDX-License-Identifier: Apache-2.0

menuconfig MPU9150
	bool "MPU9150 Nine-Axis Motion Tracking Device (MPU6050 + AK8975)"
	default y
	depends on DT_HAS_INVENSENSE_MPU9150_ENABLED
	select I2C
	help
	  Enable driver for MPU9150 I2C-based nine-axis motion tracking device.

if MPU9150

choice
	prompt "Trigger mode"
	default MPU9150_TRIGGER_NONE
	help
	  Specify the type of triggering to be used by the driver.

config MPU9150_TRIGGER_NONE
	bool "No trigger"

config MPU9150_TRIGGER_GLOBAL_THREAD
	bool "Use global thread"
	select MPU9150_TRIGGER

config MPU9150_TRIGGER_OWN_THREAD
	bool "Use own thread"
	select MPU9150_TRIGGER

config MPU9150_TRIGGER_DIRECT
	bool "Use IRQ handler"
	select MPU9150_TRIGGER
endchoice

config MPU9150_TRIGGER
	bool

config MPU9150_THREAD_PRIORITY
	int "Own thread priority"
	depends on MPU9150_TRIGGER_OWN_THREAD
	default 10
	help
	  Priority of the thread used by the driver to handle interrupts.

config MPU9150_THREAD_STACK_SIZE
	int "Own thread stack size"
	depends on MPU9150_TRIGGER_OWN_THREAD
	default 1024
	help
	  Stack size of thread used by the driver to handle interrupts.

config MPU9150_MAGN_EN
	bool "Magnetometer enable"
	default y
	help
	  Enable AK8975 builtin magnetometer.

endif # MPU9150
```

## dts/bindings/sensor/bosch,bmp280-i2c.yaml
```yaml
# Copyright (c) 2020 Facebook, Inc. and its affiliates
# Copyright (c) 2024 pck
# SPDX-License-Identifier: Apache-2.0

description: |
    Bosch BMP280 pressure sensor accessed through I2C bus

compatible: "bosch,bmp280"

include: [i2c-device.yaml, "bosch,bmp280.yaml"]
```

## dts/bindings/sensor/bosch,bmp280-spi.yaml
```yaml
# Copyright (c) 2020 Facebook, Inc. and its affiliates
# Copyright (c) 2024 pck
# SPDX-License-Identifier: Apache-2.0

description: |
    Bosch BMP280 pressure sensor accessed through SPI bus

compatible: "bosch,bmp280"

include: [spi-device.yaml, "bosch,bmp280.yaml"]
```

## dts/bindings/sensor/bosch,bmp280.yaml
```yaml
# Copyright (c) 2020 Facebook, Inc. and its affiliates
# Copyright (c) 2024 pck
# SPDX-License-Identifier: Apache-2.0

# Common fields for BMP280

include: sensor-device.yaml

properties:
  int-gpios:
    type: phandle-array

  osr-temp:
    type: int
    description: |
      Default temperature oversampling rate. Only the following values are
      allowed:
        0 samples, skip measurement (default; chip reset value)
        1 sample, 16-bit, .0050 C
        2 samples, 17-bit, .0025 C
        4 samples, 18-bit, .0012 C
        8 samples, 19-bit, .0006 C
        16 samples, 20-bit, .0003 C
    default: 0
    enum:
      - 0
      - 1
      - 2
      - 4
      - 8
      - 16

  osr-press:
    type: int
    description: |
      Default pressure oversampling rate. Only the following values are
      allowed:
        0 samples, skip measurement (default; chip reset value)
        1 sample, 16-bit, 2.62 Pa
        2 samples, 17-bit, 1.31 Pa
        4 samples, 18-bit, 0.66 Pa
        8 samples, 19-bit, 0.33 Pa
        16 samples, 20-bit, 0.16 Pa
    default: 0
    enum:
      - 0
      - 1
      - 2
      - 4
      - 8
      - 16

  iir-filter:
    type: int
    description: |
      Default IIR filter coefficient. The default 0 is the chip reset value.
    default: 0
    enum:
      - 0
      - 2
      - 4
      - 8
      - 16

  time-sb:
    type: int
    description: |
      Stand-by time duration between measurements in normal mode. Only the following values are allowed:
        5       - 0.5ms  (default; chip reset value)
        625     - 62.5ms
        1250    - 125ms
        2500    - 250ms
        5000    - 500ms
        10000   - 1000ms
        20000   - 2000ms
        40000   - 4000ms
    default: 5
    enum:
      - 5
      - 625
      - 1250
      - 2500
      - 5000
      - 10000
      - 20000
      - 40000

  spi3w-en:
    type: boolean
    description: |
      SPI 3-wire enable. The default 0 is the chip reset value.
```

## dts/bindings/sensor/invensense,mpu9150-i2c.yaml
```yaml
# Copyright (c) 2020 Facebook, Inc. and its affiliates
# Copyright (c) 2024 pck
# SPDX-License-Identifier: Apache-2.0

description: |
    InvenSense MPU-9150 Nine-Axis (Gyro + Accelerometer + Compass). See more
    info at https://invensense.tdk.com/products/motion-tracking/9-axis/mpu-9150-2/

compatible: "invensense,mpu9150"

include: [i2c-device.yaml, "invensense,mpu9150.yaml"]
```

## dts/bindings/sensor/invensense,mpu9150.yaml
```yaml
# Copyright (c) 2021 Nordic Semiconductor
# Copyright (c) 2024 pck
# SPDX-License-Identifier: Apache-2.0

# Common fields for MPU9150

include: sensor-device.yaml

properties:
  fs-sel:
    type: int
    description: |
      Selects the full scale range of the gyroscope outputs.
    default: 500
    enum:
      - 250
      - 500
      - 1000
      - 2000

  afs-sel:
    type: int
    description: |
      Selects the full scale range of the accelerometer outputs.
    default: 4
    enum:
      - 2
      - 4
      - 8
      - 16

  dlpf-cfg:
    type: int
    description: |
      Digital Low Pass Filter (DLPF) setting for both the gyroscopes and accelerometers.
    default: 188
    enum:
      - 256
      - 188
      - 98
      - 42
      - 20
      - 10
      - 5

  smplrt-div:
    type: int
    description: |
      The sensor register output, FIFO output and DMP sampling are all based on the Sample Rate.
      The Sample Rate is generated by dividing the gyroscope output rate by SMPLRT_DIV (8-bit unsigned value):
      
        Sample Rate = Gyroscope Output Rate / (1 + SMPLRT_DIV)
        
      where Gyroscope Output Rate = 8kHz when the DLPF is disabled (DLPF_CFG = 0 or 7), and 1kHz
      when the DLPF is enabled.
      
      The accelerometer output rate is 1kHz. This means that for a Sample Rate greater than 1kHz,
      the same accelerometer sample may be output to the FIFO, DMP, and sensor registers more than
      once.
    default: 0

  i2c_mst_dly:
    type: int
    description: |
      Configures the reduced access rate of I2C slaves relative to the Sample Rate. When
      a slave’s access rate is decreased relative to the Sample Rate, the slave is accessed every
        
        1 / (1 + I2C_MST_DLY) samples.
    default: 9

  irq-gpios:
    type: phandle-array
    description: |
      The INT signal default configuration is active-high.  The
      property value should ensure the flags properly describe the
      signal that is presented to the driver.
      This property is required when the trigger mode is used.
```
